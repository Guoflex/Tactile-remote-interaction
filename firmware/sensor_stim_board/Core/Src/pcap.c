#include "user_comm.h"

const uint8_t firmware_data[] =
    {
        0x00, 0x00, 0x00, 0x62, 0x63, 0x00, 0x65, 0xBE, 0x01, 0x20, 0x26, 0x42, 0x5C, 0x48, 0xA0, 0x03,
        0x22, 0x15, 0x20, 0x31, 0xA1, 0x03, 0x22, 0x15, 0x20, 0x31, 0x84, 0x01, 0x23, 0x94, 0x01, 0x00,
        0x00, 0x00, 0x00, 0x00, 0x20, 0x0B, 0x43, 0x58, 0xC0, 0xFE, 0x43, 0xC0, 0x44, 0x7A, 0x7E, 0x20,
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        0xAA, 0xF2, 0x02, 0xFF, 0xFF, 0xFF, 0xFF, 0xFF, 0xFF, 0xFF, 0xFF, 0xFF, 0xFF, 0xFF, 0xFF, 0xFF};

static volatile uint8_t pcap01_rx[I2C_RX_MAX];
static volatile uint8_t pcap01_read_done = 0;
static volatile uint8_t pcap01_wait_read_bytes = 0;

static void pcap01_send_cmd(uint8_t cmd)
{
    HAL_StatusTypeDef status = HAL_I2C_Master_Transmit(&hi2c2, PCAP01_IIC_ADDR, &cmd, 1, HAL_MAX_DELAY);
    if (status != HAL_OK)
    {
        DBG_PRINTF("PCAP01 Send Cmd Failed: 0x%02X\r\n", cmd);
    }
}

static void pcap01_write_sram(uint16_t addr, uint8_t data)
{
    uint8_t value[3];
    uint16_t cmd_2 = PCAP01_WRITE_SRAM | addr;

    value[0] = (cmd_2 >> 8) & 0xFF;
    value[1] = cmd_2 & 0xFF;
    value[2] = data;

    HAL_StatusTypeDef status = HAL_I2C_Master_Transmit(&hi2c2, PCAP01_IIC_ADDR, value, 3, HAL_MAX_DELAY);
    if (status != HAL_OK)
    {
        DBG_PRINTF("PCAP01 Write SRAM Failed: Addr 0x%02X Data 0x%02X\r\n", addr, data);
    }
}

void pcap01_read_sram_start(uint16_t addr)
{
    uint16_t cmd = PCAP01_READ_SRAM | addr;
    uint8_t pcap01_tx[2];
    pcap01_tx[0] = (cmd >> 8) & 0xFF;
    pcap01_tx[1] = cmd & 0xFF;
    pcap01_read_done = 0;
    pcap01_wait_read_bytes = 1;
    HAL_I2C_Master_Seq_Transmit_IT(&hi2c2, PCAP01_IIC_ADDR, pcap01_tx, 2, I2C_FIRST_FRAME);
}

static uint8_t pcap01_read_sram(uint16_t addr)
{

    pcap01_read_sram_start(addr);

    // DBG_PRINTF("PCAP01 Read SRAM Start: Addr 0x%02X, wait for completion\r\n", addr);

    while (!pcap01_read_done)
    {
        // 喂狗
        HAL_IWDG_Refresh(&hiwdg1);
    }

    return pcap01_rx[0];
}

// WASTED
static uint8_t pcap01_read_sram_(uint16_t addr)
{
    uint8_t cmd_2 = PCAP01_READ_SRAM | addr;
    uint8_t tx_data[2];
    uint8_t rx_data[1];

    tx_data[0] = (cmd_2 >> 8) & 0xFF;
    tx_data[1] = cmd_2 & 0xFF;

    HAL_StatusTypeDef status;

    status = HAL_I2C_Master_Seq_Transmit_DMA(&hi2c2, PCAP01_IIC_ADDR, tx_data, 2, I2C_FIRST_FRAME);
    if (status != HAL_OK)
    {
        DBG_PRINTF("PCAP01 Read SRAM Failed (Send Addr): Addr 0x%02X\r\n", addr);
        return 0;
    }

    delay_us(100); // 确保有足够时间让PCAP01准备数据

    status = HAL_I2C_Master_Seq_Receive_DMA(&hi2c2, PCAP01_IIC_ADDR, rx_data, 1, I2C_LAST_FRAME);
    if (status != HAL_OK)
    {
        DBG_PRINTF("PCAP01 Read SRAM Failed (Read Data): Addr 0x%02X\r\n", addr);
        return 0;
    }

    return rx_data[0];
}

// PCAP01 连接状态检测
static uint8_t pcap01_state_check(void)
{

    uint8_t test_data_1 = 0x5A;
    uint8_t test_count = 0;

    uint8_t data_1 = 0;
    while (test_count < 20)
    {
        pcap01_write_sram(0x0047, test_data_1);

        data_1 = pcap01_read_sram(0x0047);

        // DBG_PRINTF("PCAP01 State Check Attempt %d: Wrote 0x%02X, Read 0x%02X\r\n", test_count + 1, test_data_1, data_1);

        if (data_1 == test_data_1)
        {
            return 1; // PCAP01 正常
        }
        else
        {
            // 准备重试
            test_count++;
            delay_ms(10);
        }
    }

    return 0; // PCAP01 检测失败
}

static void pcap01_write_firmware(void)
{

    uint16_t i = 0;

    for (i = 0; i < sizeof(firmware_data); i++)
    {
        pcap01_write_sram(i, firmware_data[i]);
    }

    DBG_PRINTF("PCAP01 Firmware Write Completed\r\n");

    // read back to verify
    for (i = 0; i < sizeof(firmware_data); i++)
    {
        uint8_t read_data = pcap01_read_sram(i);

        if (read_data != firmware_data[i])
        {
            DBG_PRINTF("PCAP01 Firmware Verify Failed at Addr 0x%04X\r\n", i);
            return;
        }
    }

    DBG_PRINTF("PCAP01 Firmware Verify Succeeded\r\n");
}

static error_t pcap01_write_register(uint8_t addr, uint32_t param) // 写寄存器
{

    uint8_t value[5];
    value[0] = PCAP01_WRITE_CFG | addr;
    value[1] = (param >> 16) & 0xFF;
    value[2] = (param >> 8) & 0xFF;
    value[3] = param & 0xFF;

    HAL_StatusTypeDef status = HAL_I2C_Master_Transmit(&hi2c2, PCAP01_IIC_ADDR, value, 4, HAL_MAX_DELAY);
    if (status != HAL_OK)
    {
        DBG_PRINTF("PCAP01 Write Register Failed: Addr 0x%02X Param 0x%06X\r\n", addr, param);
        return ERR_I2C_NACK;
    }

    return ERR_OK;
}

static void pcap01_cfg_reg(void) // pcap01 配置寄存器参数
{
    pcap01_write_register(0, 0x4200FF); // slave mode
    pcap01_write_register(1, 0x201004); // 01.50hz   35-10hz，22-50hz，13-100hz，04-200hz

    pcap01_write_register(2, 0x0F470B); // 0x0F470B 0x0F460B//0x0F450B//0x0F050B   0xFF170B所有通道

    // REG2：enable PC0–PC3，明确两对差分
    // pcap01_write_register(2, 0xFF170B); // 你自己注释里的“所有通道”

    pcap01_write_register(3, 0x0D0001); // 0x0D0001
    pcap01_write_register(4, 0x041300); // 0x041300 h xx xx 01  @abner 2019.10.30 setting based on datasheet
    pcap01_write_register(5, 0x000000); // h cx xx xx
    pcap01_write_register(6, 0x000040); // h 00 43 40
    pcap01_write_register(7, 0x1F0000);
    pcap01_write_register(8, 0x800010);
    pcap01_write_register(9, 0xFF000F);

    pcap01_write_register(10, 0x180087);

    // REG10：scan sequence 包含 2 个 channel pair
    // pcap01_write_register(10, 0x180187); // 示例：scan ch0 + ch1

    pcap01_write_register(20, 0x000001);
}

void pcap_init(void)
{

    delay_ms(200);

    // 先发送上电复位命令
    pcap01_send_cmd(PCAP01_POWER_RESET);

    // 等待10ms
    delay_ms(10);

    if (pcap01_state_check())
    {

        DBG_PRINTF("PCAP01 Detected Successfully\r\n");
        // 写固件
        pcap01_write_firmware();

        DBG_PRINTF("PCAP01 config reg\r\n");
        // 写配置寄存器
        pcap01_cfg_reg();

        DBG_PRINTF("PCAP01 send soft reset\r\n");
        // 发送软复位
        pcap01_send_cmd(PCAP01_SOFT_RESET);

        // 再等10ms
        delay_ms(10);

        DBG_PRINTF("PCAP01 enable capacitive measurement\r\n");
        // 开启电容测量
        pcap01_send_cmd(PCAP01_MEAS_CAP);
    }
    else
    {
        DBG_PRINTF("PCAP01 Detection Failed\r\n");
    }

    // delay 500ms
    delay_ms(500);

    DBG_PRINTF("PCAP01 Init Finished\r\n");
}

void HAL_I2C_MasterTxCpltCallback(I2C_HandleTypeDef *hi2c)
{
    if (hi2c == &hi2c2)
    {
        // DBG_PRINTF("PCAP01 I2C TX Complete, start RX\r\n");
        HAL_I2C_Master_Seq_Receive_IT(&hi2c2, PCAP01_IIC_ADDR, pcap01_rx, pcap01_wait_read_bytes, I2C_LAST_FRAME);
    }
}

void HAL_I2C_MasterRxCpltCallback(I2C_HandleTypeDef *hi2c)
{
    if (hi2c == &hi2c2)
    {
        pcap01_read_done = 1;
    }
}

void pcap01_read_res_start(uint8_t addr)
{
    uint8_t pcap01_tx_buf[1];
    pcap01_tx_buf[0] = PCAP01_READ_RES | addr;
    pcap01_read_done = 0;

    pcap01_wait_read_bytes = 3;

    // Write opcode, no STOP
    // 0xA0
    HAL_I2C_Master_Seq_Transmit_IT(&hi2c2, PCAP01_IIC_ADDR, pcap01_tx_buf, 1, I2C_FIRST_FRAME);
}

// 读取结果寄存器
float pcap01_read_result(uint8_t addr)
{

    pcap01_read_res_start(addr);

    while (!pcap01_read_done)
    {
        // 喂狗
        // HAL_IWDG_Refresh(&hiwdg1);
    }

    uint32_t pcap01_res_raw = ((uint32_t)pcap01_rx[0] << 16) | ((uint32_t)pcap01_rx[1] << 8) | (uint32_t)pcap01_rx[2];
    // DBG_PRINTF("PCAP01 Raw Result from Addr 0x%02X: 0x%06X\r\n", addr, pcap01_res_raw);

    if (pcap01_res_raw == 0xFFFFFF)
    {
        pcap01_res_raw = 0;
    }

    // float result = pcap01_res_raw * RER_CAPTER / 2097152.0f;
    float result = (pcap01_res_raw >> 1) * (RER_CAPTER / 1048576.0f);

    return result;
}

void pcap_send_PCAP01_MEAS_CAP(void)
{
    // 读取PCAP数据
    pcap01_send_cmd(PCAP01_MEAS_CAP);
}